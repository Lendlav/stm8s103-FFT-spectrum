#include "stm8s.h" 
#include "main.h"
#include "SSD1306.h"

//----------------------------------------------------------------------------------
#define DATA_MODE       0x40
#define COMMAND_MODE    0x00   // bit Co = 0, D/C# = 0
#define BUFF_SIZE       512

#define column_start  0
#define column_end    127
#define page_start    0
#define page_end      3

//----------------------------------------------------------------------------------
u8  lcd_buff[BUFF_SIZE];
u16 lcd_buff_idx=0;
u8  x_cur=0, y_cur=0;

const u8 comm[]={ 
   0xAE,             //Display Off
   0xD5,0x80,
   0xA8,0x1F,        //Set Multiplex Ratio              
   0xD3,0x00,
   0x40,
   
   0x8D,0x14,        // Charge Pump set:   0x10 = VCC Supplied Externally  
                     // 0x14 = VCC Generated by Internal

   //[1:0] = 00b, Horizontal Addressing Mode
   //[1:0] = 01b, Vertical Addressing Mode
   //[1:0] = 10b, Page Addressing Mode (RESET)
   //[1:0] = 11b, Invalid   
   0x20,0x01,        //Set Memory Addressing Mode 
   
   0xA1,             //Set Segment Re-map
   0xC8,             //Vertical flip    C0/C8
   
   0xDA,0x02,        //Set COM Pins Hardware Configuration 
   
   0x81,0x0A,        //Set Contrast Control 
   0xD9,0xF1,        //Set Pre-Charge Period:  0x22 = VCC Supplied Externally  \
                     //0xF1 = VCC Generated by Internal             
      
   0xDB,0x40,        //Set VCOMH Deselect Level
      
   0xA4,             //Set Entire Display On/Off
   0xA6,             //Set NORMAL/INVERT Display   A6/A7
   
   0xAF,             //Display On
   
   0xFF
};
//----------------------------------------------------------------------------------

void LCD_Init(void)
{
  u8 ix = 0;
  while(comm[ix]!=0xFF)
  {
     LCD_command(comm[ix]);
     ix++;
  }
}
//----------------------------------------------------------------------------------
void LCD_On(void)
{
   LCD_command(0xAF);
}
//----------------------------------------------------------------------------------
void LCD_Off(void)
{
   LCD_command(0xAE);
}
//----------------------------------------------------------------------------------

void LCD_Clear(void)
{
   u16 ix;
   for(ix=0;ix<BUFF_SIZE;ix++)
   {
      lcd_buff[ix]=0x00;
   }
   x_cur=0;
   y_cur=0;
}

//----------------------------------------------------------------------------------

void LCD_Update(void)
{
   u16 ix = 0;
   
   LCD_command(0x21);           // SSD1306_COLUMNADDR
   LCD_command(column_start);   // column start
   LCD_command(column_end);     // column end
   LCD_command(0x22);           // SSD1306_PAGEADDR
   LCD_command(page_start);     // page start
   LCD_command(page_end);       // page end (4 pages for 32 rows OLED)
   
   disableInterrupts();
   
   I2C_GenerateSTART(ENABLE);
   while (!I2C_CheckEvent(I2C_EVENT_MASTER_MODE_SELECT));
   I2C_Send7bitAddress(SLAVE_ADDRESS, I2C_DIRECTION_TX);
   while (!I2C_CheckEvent(I2C_EVENT_MASTER_TRANSMITTER_MODE_SELECTED));
   I2C_SendData(DATA_MODE);
   while (!I2C_CheckEvent(I2C_EVENT_MASTER_BYTE_TRANSMITTING));  
   
   for(ix=0;ix<BUFF_SIZE;ix++)
   {
      I2C_SendData(lcd_buff[ix]);
      while (!I2C_CheckEvent(I2C_EVENT_MASTER_BYTE_TRANSMITTING));
   } 
   I2C_GenerateSTOP(ENABLE);
   
   enableInterrupts();
}
//----------------------------------------------------------------------------------

void LCD_Chr(u8 ch)
{
   u8 i;   
   lcd_buff_idx=y_cur*128+x_cur*6;    
   if ((ch>=0x20)&&(ch<=0x7F)) ch-=32;
   else if (ch>=0xC0) ch-=96;
   else ch = 95;   
   for (i=0;i<5;i++)
   {
      lcd_buff[lcd_buff_idx++] = font[ch][i];
   }
   lcd_buff[lcd_buff_idx++] = 0x00;  
   x_cur++;
   if (x_cur>20)
   {
      x_cur=0;
      y_cur++;
      if (y_cur>3)
      {
         y_cur=0;
      }
   }
}
//----------------------------------------------------------------------------------

void LCD_FStr(const u8 *dataPtr){
   while(*dataPtr!=0){
      LCD_Chr(*dataPtr);
      dataPtr++;
   }
}
//----------------------------------------------------------------------------------

void LCD_GotoXY(u8 x,u8 y){
    if((x<21)&&(y<4)){
      x_cur=x;
      y_cur=y;
    }
}
//----------------------------------------------------------------------------------

void  LCD_command(u8 cmd){
   
   disableInterrupts();
   
   I2C_GenerateSTART(ENABLE);
   while (!I2C_CheckEvent(I2C_EVENT_MASTER_MODE_SELECT));
   I2C_Send7bitAddress(SLAVE_ADDRESS, I2C_DIRECTION_TX);
   while (!I2C_CheckEvent(I2C_EVENT_MASTER_TRANSMITTER_MODE_SELECTED));
   I2C_SendData(COMMAND_MODE);       // bit Co = 0, D/C# = 0
   while (!I2C_CheckEvent(I2C_EVENT_MASTER_BYTE_TRANSMITTING));   
   I2C_SendData(cmd);
   while (!I2C_CheckEvent(I2C_EVENT_MASTER_BYTE_TRANSMITTING));
   I2C_GenerateSTOP(ENABLE);
   
   enableInterrupts();
}





